## conf/layer.conf
```bitbake
# We have a conf and classes directory, append to BBPATH
BBPATH .= ":${LAYERDIR}"

# We have a recipes directory, add to BBFILES
BBFILES += " \
    ${LAYERDIR}/recipes-*/*/*.bb \
    ${LAYERDIR}/recipes-*/*/*.bbappend \
    ${LAYERDIR}/images/*.bb \
"

BBFILE_COLLECTIONS += "meta-snake-tegra"
BBFILE_PATTERN_meta-snake-tegra = "^${LAYERDIR}/"
BBFILE_PRIORITY_meta-snake-tegra = "5"

LAYERVERSION_tegra = "1"
LAYERDEPENDS_tegra = "core"
LAYERSERIES_COMPAT_meta-snake-tegra = "warrior"
```
